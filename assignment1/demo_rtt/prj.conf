## CMakeLists.txt
```
# SPDX-License-Identifier: Apache-2.0
cmake_minimum_required(VERSION 3.20.0)

# set board variable to thingy:52 for cross-compilation, needs to be done before including/finding zephyr
set(BOARD "thingy52_nrf52832")

find_package(Zephyr REQUIRED HINTS $ENV{ZEPHYR_BASE})

project(my_fancy_demo)

target_sources(app PRIVATE src/main.c)
```

## prj.conf
```kconfig
CONFIG_USE_SEGGER_RTT=y
CONFIG_RTT_CONSOLE=y

CONFIG_UART_CONSOLE=n # disable uart console explicitly
```

## src/main.c
```c
#include <zephyr/kernel.h>

int main() {
  printk("Starting system.\n");

  while (true) {
    printk("Test.\n");
    k_msleep(500);
  }
}
```
